## vendor/huawei/hdf/Kconfig
```kconfig
# Copyright (c) 2020 Huawei Device Co., Ltd. All rights reserved.

source "../../vendor/hisi/hi35xx/platform/Kconfig"
source "../../vendor/huawei/hdf/wifi/driver/Kconfig"
source "../../vendor/huawei/hdf/input/driver/Kconfig"
source "../../vendor/huawei/hdf/display/driver/Kconfig"
```
